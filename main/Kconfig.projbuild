## main/Kconfig.projbuild
```kconfig
menu "Project configuration"

    config ESP_WIFI_SSID
        string "WiFi SSID"
        default "myssid"
        help
            SSID (network name) for the example to connect to.

    config ESP_WIFI_PASSWORD
        string "WiFi Password"
        default "mypassword"
        help
            WiFi password (WPA or WPA2) for the example to use.

    config ESP_MAXIMUM_RETRY
        int "Maximum retry"
        default 5
        help
            Set the Maximum retry to avoid station reconnecting to the AP unlimited when the AP is really inexistent.

    config GG_MOBILE
        string "GG mobile"
        default "+374"
        help
            Your GG taxi account mobile number.

    config GG_PASSWORD
        string "GG password"
        default ""
        help
            Your GG taxi account password.

	config HOME_LAT
        string "Home lat"
        default ""
        help
			None

	config HOME_LNG
        string "Home lng"
        default ""
        help
			None

	config HOME_ADDR
        string "Home address in text"
        default ""
        help
			None

endmenu
```
